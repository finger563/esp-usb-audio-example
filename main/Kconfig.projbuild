## main/Kconfig.projbuild
```kconfig
menu "USB Audio Configuration"

    menu "TinyUSB task configuration"
        config TINYUSB_NO_DEFAULT_TASK
            bool "Do not create a TinyUSB task"
            default n
            help
                This option allows to not create the FreeRTOS task during the driver initialization.
                User will have to handle TinyUSB events manually.

        config TINYUSB_TASK_PRIORITY
            int "TinyUSB task priority"
            default 5
            depends on !TINYUSB_NO_DEFAULT_TASK
            help
                Set the priority of the default TinyUSB main task.

        config TINYUSB_TASK_STACK_SIZE
            int "TinyUSB task stack size (bytes)"
            default 4096
            depends on !TINYUSB_NO_DEFAULT_TASK
            help
                Set the stack size of the default TinyUSB main task.

        choice TINYUSB_TASK_AFFINITY
            prompt "TinyUSB task affinity"
            default TINYUSB_TASK_AFFINITY_NO_AFFINITY
            depends on !TINYUSB_NO_DEFAULT_TASK
            help
                Allows setting TinyUSB tasks affinity, i.e. whether the task is pinned to
                CPU0, pinned to CPU1, or allowed to run on any CPU.

            config TINYUSB_TASK_AFFINITY_NO_AFFINITY
                bool "No affinity"
            config TINYUSB_TASK_AFFINITY_CPU0
                bool "CPU0"
            config TINYUSB_TASK_AFFINITY_CPU1
                bool "CPU1"
                depends on !FREERTOS_UNICORE
        endchoice

        config TINYUSB_TASK_AFFINITY
            hex
            default FREERTOS_NO_AFFINITY if TINYUSB_TASK_AFFINITY_NO_AFFINITY
            default 0x0 if TINYUSB_TASK_AFFINITY_CPU0
            default 0x1 if TINYUSB_TASK_AFFINITY_CPU1

        config TINYUSB_INIT_IN_DEFAULT_TASK
            bool "Initialize TinyUSB stack within the default TinyUSB task"
            default n
            depends on !TINYUSB_NO_DEFAULT_TASK
            help
                Run TinyUSB stack initialization just after starting the default TinyUSB task.
                This is especially useful in multicore scenarios, when we need to pin the task
                to a specific core and, at the same time initialize TinyUSB stack
                (i.e. install interrupts) on the same core.
    endmenu

endmenu
```

## sdkconfig.defaults
```kconfig
# TODO: uncomment one of these if you want to support a specifc target by default
# CONFIG_IDF_TARGET="esp32"
# CONFIG_IDF_TARGET="esp32s2"
# CONFIG_IDF_TARGET="esp32s3"
# CONFIG_IDF_TARGET="esp32c3"

# TODO: uncomment if you want freertos to run at 1 khz instead of the default 100 hz
# CONFIG_FREERTOS_HZ=1000

# TODO: uncomment if you want to run the esp at max clock speed (240 mhz)
# ESP32-specific
#
# CONFIG_ESP_DEFAULT_CPU_FREQ_MHZ_240=y
# CONFIG_ESP_DEFAULT_CPU_FREQ_MHZ=240

# TODO: uncomment if you want to update the event and main task stask sizes
# Common ESP-related
#
# CONFIG_ESP_SYSTEM_EVENT_TASK_STACK_SIZE=4096
# CONFIG_ESP_MAIN_TASK_STACK_SIZE=8192

# TODO: uncomment if you want to enable exceptions (which may be needed by certain components such as cli)
# CONFIG_COMPILER_CXX_EXCEPTIONS=y
```
